/* Generated by tools/disasm.py - objects in ROM order */
OUTPUT_FORMAT("coff-h8300")
OUTPUT_ARCH(h8300hn)
ENTRY(vectors)

SECTIONS
{
	.text 0x0000 :
	{
		build/asm/header.o(.text)
		build/asm/code/func_0078.o(.text)
		build/asm/code/Start.o(.text)
		build/asm/code/func_03b4.o(.text)
		build/asm/code/func_0426.o(.text)
		build/asm/code/func_048c.o(.text)
		build/asm/code/func_0636.o(.text)
		build/asm/code/func_06de.o(.text)
		build/asm/code/func_06fa.o(.text)
		build/asm/code/func_0714.o(.text)
		build/asm/code/func_075a.o(.text)
		build/asm/code/func_075c.o(.text)
		build/asm/code/func_0772.o(.text)
		build/asm/code/func_07f2.o(.text)
		build/asm/code/func_0822.o(.text)
		build/asm/code/func_082e.o(.text)
		build/asm/code/func_0832.o(.text)
		build/asm/code/func_0880.o(.text)
		build/asm/code/func_08d6.o(.text)
		build/asm/code/func_1856.o(.text)
		build/asm/code/func_187e.o(.text)
		build/asm/code/func_188c.o(.text)
		build/asm/code/func_18a8.o(.text)
		build/asm/code/func_18b6.o(.text)
		build/asm/code/func_1936.o(.text)
		build/asm/code/func_1972.o(.text)
		build/asm/code/func_19b8.o(.text)
		build/asm/code/func_1a0a.o(.text)
		build/asm/code/func_1a58.o(.text)
		build/asm/code/func_1ab2.o(.text)
		build/asm/code/func_1af4.o(.text)
		build/asm/code/func_1b40.o(.text)
		build/asm/code/func_1b94.o(.text)
		build/asm/code/func_1bc6.o(.text)
		build/asm/code/func_1c26.o(.text)
		build/asm/code/func_1c80.o(.text)
		build/asm/code/func_1cbe.o(.text)
		build/asm/code/func_1cf0.o(.text)
		build/asm/code/func_1d22.o(.text)
		build/asm/code/func_1d7a.o(.text)
		build/asm/code/func_1dca.o(.text)
		build/asm/code/func_1eca.o(.text)
		build/asm/code/func_1eee.o(.text)
		build/asm/code/func_1f1c.o(.text)
		build/asm/code/func_1f3e.o(.text)
		build/asm/code/func_1f6c.o(.text)
		build/asm/code/func_1fee.o(.text)
		build/asm/code/func_2096.o(.text)
		build/asm/code/func_2178.o(.text)
		build/asm/code/func_21fe.o(.text)
		build/asm/code/func_224c.o(.text)
		build/asm/code/func_245e.o(.text)
		build/asm/code/func_246c.o(.text)
		build/asm/code/func_247e.o(.text)
		build/asm/code/func_2488.o(.text)
		build/asm/code/func_24ac.o(.text)
		build/asm/code/func_256e.o(.text)
		build/asm/code/func_259e.o(.text)
		build/asm/code/func_25ac.o(.text)
		build/asm/code/func_25c8.o(.text)
		build/asm/code/func_25d0.o(.text)
		build/asm/code/func_25f6.o(.text)
		build/asm/code/func_2680.o(.text)
		build/asm/code/func_26a0.o(.text)
		build/asm/code/func_270a.o(.text)
		build/asm/code/func_273c.o(.text)
		build/asm/code/func_27c2.o(.text)
		build/asm/code/func_27ec.o(.text)
		build/asm/code/func_281e.o(.text)
		build/asm/code/func_289a.o(.text)
		build/asm/code/func_290a.o(.text)
		build/asm/code/func_2938.o(.text)
		build/asm/code/func_2972.o(.text)
		build/asm/code/func_2a96.o(.text)
		build/asm/code/func_2c32.o(.text)
		build/asm/code/func_2c62.o(.text)
		build/asm/code/func_2c94.o(.text)
		build/asm/code/func_2ca0.o(.text)
		build/asm/code/func_2cdc.o(.text)
		build/asm/code/func_2d9a.o(.text)
		build/asm/code/func_2e48.o(.text)
		build/asm/code/func_2ee2.o(.text)
		build/asm/code/func_2ef2.o(.text)
		build/asm/code/func_2f0e.o(.text)
		build/asm/code/func_2f8c.o(.text)
		build/asm/code/func_2fac.o(.text)
		build/asm/code/func_2fc4.o(.text)
		build/asm/code/func_2fcc.o(.text)
		build/asm/code/func_2ffa.o(.text)
		build/asm/code/func_302c.o(.text)
		build/asm/code/func_304a.o(.text)
		build/asm/code/func_3070.o(.text)
		build/asm/code/func_3088.o(.text)
		build/asm/code/func_30a6.o(.text)
		build/asm/code/func_3298.o(.text)
		build/asm/code/func_32d6.o(.text)
		build/asm/code/func_331c.o(.text)
		build/asm/code/func_333a.o(.text)
		build/asm/code/func_341c.o(.text)
		build/asm/code/func_34ba.o(.text)
		build/asm/code/func_34e8.o(.text)
		build/asm/code/func_3502.o(.text)
		build/asm/code/func_350e.o(.text)
		build/asm/code/func_3546.o(.text)
		build/asm/code/func_3552.o(.text)
		build/asm/code/func_3556.o(.text)
		build/asm/code/func_3558.o(.text)
		build/asm/code/func_35b0.o(.text)
		build/asm/code/func_360a.o(.text)
		build/asm/code/func_3670.o(.text)
		build/asm/code/func_369c.o(.text)
		build/asm/code/func_36aa.o(.text)
		build/asm/code/func_36f2.o(.text)
		build/asm/code/func_37c6.o(.text)
		build/asm/code/func_37d6.o(.text)
		build/asm/code/func_3810.o(.text)
		build/asm/code/func_3832.o(.text)
		build/asm/code/func_3838.o(.text)
		build/asm/code/func_388c.o(.text)
		build/asm/code/func_3a4a.o(.text)
		build/asm/code/func_3a68.o(.text)
		build/asm/code/func_3a70.o(.text)
		build/asm/code/func_3b02.o(.text)
		build/asm/code/func_3b94.o(.text)
		build/asm/code/func_3c0a.o(.text)
		build/asm/code/func_3c76.o(.text)
		build/asm/code/func_3cd8.o(.text)
		build/asm/code/func_3dbc.o(.text)
		build/asm/code/func_3e34.o(.text)
		build/asm/code/func_3ece.o(.text)
		build/asm/code/func_3f32.o(.text)
		build/asm/code/func_3f72.o(.text)
		build/asm/code/func_3fc6.o(.text)
		build/asm/code/func_3ffc.o(.text)
		build/asm/code/func_4026.o(.text)
		build/asm/code/func_4058.o(.text)
		build/asm/code/func_406c.o(.text)
		build/asm/code/func_4094.o(.text)
		build/asm/code/func_409a.o(.text)
		build/asm/code/func_40a2.o(.text)
		build/asm/code/func_40a8.o(.text)
		build/asm/code/func_40f8.o(.text)
		build/asm/code/func_4148.o(.text)
		build/asm/code/func_4178.o(.text)
		build/asm/code/func_42a0.o(.text)
		build/asm/code/func_42d0.o(.text)
		build/asm/code/func_4310.o(.text)
		build/asm/code/func_4372.o(.text)
		build/asm/code/func_43e4.o(.text)
		build/asm/code/func_4434.o(.text)
		build/asm/code/func_449e.o(.text)
		build/asm/code/func_44f4.o(.text)
		build/asm/code/func_4546.o(.text)
		build/asm/code/func_4792.o(.text)
		build/asm/code/func_47ce.o(.text)
		build/asm/code/func_499c.o(.text)
		build/asm/code/func_49ae.o(.text)
		build/asm/code/func_49c0.o(.text)
		build/asm/code/func_4af2.o(.text)
		build/asm/code/func_4b9c.o(.text)
		build/asm/code/func_4cd6.o(.text)
		build/asm/code/func_4f50.o(.text)
		build/asm/code/func_4f70.o(.text)
		build/asm/code/func_4f92.o(.text)
		build/asm/code/func_4fa0.o(.text)
		build/asm/code/func_4fca.o(.text)
		build/asm/code/func_50d8.o(.text)
		build/asm/code/func_5128.o(.text)
		build/asm/code/func_524e.o(.text)
		build/asm/code/func_5384.o(.text)
		build/asm/code/func_552e.o(.text)
		build/asm/code/func_5634.o(.text)
		build/asm/code/func_5742.o(.text)
		build/asm/code/func_5874.o(.text)
		build/asm/code/func_5990.o(.text)
		build/asm/code/func_5c0a.o(.text)
		build/asm/code/func_5d52.o(.text)
		build/asm/code/func_5e9e.o(.text)
		build/asm/code/func_5edc.o(.text)
		build/asm/code/func_5fc2.o(.text)
		build/asm/code/func_60da.o(.text)
		build/asm/code/func_632c.o(.text)
		build/asm/code/func_6380.o(.text)
		build/asm/code/func_6382.o(.text)
		build/asm/code/func_6528.o(.text)
		build/asm/code/func_6574.o(.text)
		build/asm/code/func_6784.o(.text)
		build/asm/code/func_67de.o(.text)
		build/asm/code/func_6816.o(.text)
		build/asm/code/func_693a.o(.text)
		build/asm/code/func_694c.o(.text)
		build/asm/code/func_69b8.o(.text)
		build/asm/code/func_69be.o(.text)
		build/asm/code/func_6a1c.o(.text)
		build/asm/code/func_6a3e.o(.text)
		build/asm/code/func_6ad8.o(.text)
		build/asm/code/func_6b10.o(.text)
		build/asm/code/func_6b4c.o(.text)
		build/asm/code/func_6ba0.o(.text)
		build/asm/code/func_6bf8.o(.text)
		build/asm/code/func_6c88.o(.text)
		build/asm/code/func_6c94.o(.text)
		build/asm/code/func_6ce2.o(.text)
		build/asm/code/func_6d6c.o(.text)
		build/asm/code/func_6dfc.o(.text)
		build/asm/code/func_6e62.o(.text)
		build/asm/code/func_703c.o(.text)
		build/asm/code/func_711a.o(.text)
		build/asm/code/func_71a4.o(.text)
		build/asm/code/func_722c.o(.text)
		build/asm/code/func_728a.o(.text)
		build/asm/code/func_72d0.o(.text)
		build/asm/code/func_72da.o(.text)
		build/asm/code/func_72e4.o(.text)
		build/asm/code/func_72f8.o(.text)
		build/asm/code/func_730c.o(.text)
		build/asm/code/func_7320.o(.text)
		build/asm/code/func_7334.o(.text)
		build/asm/code/func_7348.o(.text)
		build/asm/code/func_7366.o(.text)
		build/asm/code/func_736e.o(.text)
		build/asm/code/func_7376.o(.text)
		build/asm/code/func_737c.o(.text)
		build/asm/code/func_7382.o(.text)
		build/asm/code/func_7388.o(.text)
		build/asm/code/func_738e.o(.text)
		build/asm/code/func_7394.o(.text)
		build/asm/code/func_739a.o(.text)
		build/asm/code/func_73a0.o(.text)
		build/asm/code/func_73a6.o(.text)
		build/asm/code/func_73ac.o(.text)
		build/asm/code/func_73b2.o(.text)
		build/asm/code/func_73b8.o(.text)
		build/asm/code/func_73dc.o(.text)
		build/asm/code/func_73e2.o(.text)
		build/asm/code/func_73e8.o(.text)
		build/asm/code/func_73ee.o(.text)
		build/asm/code/func_73f4.o(.text)
		build/asm/code/func_7406.o(.text)
		build/asm/code/func_7420.o(.text)
		build/asm/code/func_743a.o(.text)
		build/asm/code/func_7440.o(.text)
		build/asm/code/func_7446.o(.text)
		build/asm/code/func_744c.o(.text)
		build/asm/code/func_7452.o(.text)
		build/asm/code/func_7458.o(.text)
		build/asm/code/func_745e.o(.text)
		build/asm/code/func_7464.o(.text)
		build/asm/code/func_746a.o(.text)
		build/asm/code/func_7470.o(.text)
		build/asm/code/func_7476.o(.text)
		build/asm/code/func_747c.o(.text)
		build/asm/code/func_7482.o(.text)
		build/asm/code/func_7496.o(.text)
		build/asm/code/func_749c.o(.text)
		build/asm/code/func_74a2.o(.text)
		build/asm/code/func_74a8.o(.text)
		build/asm/code/func_74ae.o(.text)
		build/asm/code/func_74b4.o(.text)
		build/asm/code/func_74bc.o(.text)
		build/asm/code/func_76aa.o(.text)
		build/asm/code/func_7882.o(.text)
		build/asm/code/func_7998.o(.text)
		build/asm/code/func_7a0a.o(.text)
		build/asm/code/func_7a40.o(.text)
		build/asm/code/func_7b44.o(.text)
		build/asm/code/func_7b64.o(.text)
		build/asm/code/func_7b72.o(.text)
		build/asm/code/func_7c24.o(.text)
		build/asm/code/func_7c56.o(.text)
		build/asm/code/func_7cac.o(.text)
		build/asm/code/func_7cfa.o(.text)
		build/asm/code/func_7d4a.o(.text)
		build/asm/code/func_7e58.o(.text)
		build/asm/code/func_7fb8.o(.text)
		build/asm/code/func_7fda.o(.text)
		build/asm/code/func_7ffc.o(.text)
		build/asm/code/func_80ac.o(.text)
		build/asm/code/func_82ea.o(.text)
		build/asm/code/func_8766.o(.text)
		build/asm/code/func_88e2.o(.text)
		build/asm/code/func_8a36.o(.text)
		build/asm/code/func_8aca.o(.text)
		build/asm/code/func_8bd2.o(.text)
		build/asm/code/func_8c62.o(.text)
		build/asm/code/func_8ca4.o(.text)
		build/asm/code/func_8cf4.o(.text)
		build/asm/code/func_8d02.o(.text)
		build/asm/code/func_8d88.o(.text)
		build/asm/code/func_8dd4.o(.text)
		build/asm/code/func_8dea.o(.text)
		build/asm/code/func_8e5a.o(.text)
		build/asm/code/func_8e8e.o(.text)
		build/asm/code/func_8ebe.o(.text)
		build/asm/code/func_8f24.o(.text)
		build/asm/code/func_9108.o(.text)
		build/asm/code/func_9116.o(.text)
		build/asm/code/func_918c.o(.text)
		build/asm/code/func_9328.o(.text)
		build/asm/code/func_9342.o(.text)
		build/asm/code/func_945a.o(.text)
		build/asm/code/func_9698.o(.text)
		build/asm/code/func_974e.o(.text)
		build/asm/code/func_9756.o(.text)
		build/asm/code/func_97b2.o(.text)
		build/asm/code/func_980e.o(.text)
		build/asm/code/func_9856.o(.text)
		build/asm/code/func_985e.o(.text)
		build/asm/code/func_986a.o(.text)
		build/asm/code/func_98b0.o(.text)
		build/asm/code/func_9930.o(.text)
		build/asm/code/func_9b34.o(.text)
		build/asm/code/func_9b84.o(.text)
		build/asm/code/func_9c40.o(.text)
		build/asm/code/func_9c48.o(.text)
		build/asm/code/func_9d92.o(.text)
		build/asm/code/func_9dce.o(.text)
		build/asm/code/func_9e72.o(.text)
		build/asm/code/func_9f44.o(.text)
		build/asm/code/func_a10a.o(.text)
		build/asm/code/func_a12c.o(.text)
		build/asm/code/func_a180.o(.text)
		build/asm/code/func_a1a8.o(.text)
		build/asm/code/func_a29c.o(.text)
		build/asm/code/func_a2da.o(.text)
		build/asm/code/func_a2f6.o(.text)
		build/asm/code/func_a300.o(.text)
		build/asm/code/func_a31c.o(.text)
		build/asm/code/func_a322.o(.text)
		build/asm/code/func_a328.o(.text)
		build/asm/code/func_a32e.o(.text)
		build/asm/code/func_a34a.o(.text)
		build/asm/code/func_a396.o(.text)
		build/asm/code/func_a3aa.o(.text)
		build/asm/code/func_a45e.o(.text)
		build/asm/code/func_a4fe.o(.text)
		build/asm/code/func_a65e.o(.text)
		build/asm/code/func_a674.o(.text)
		build/asm/code/func_a682.o(.text)
		build/asm/code/func_a6e2.o(.text)
		build/asm/code/func_a704.o(.text)
		build/asm/code/func_a72a.o(.text)
		build/asm/code/func_a800.o(.text)
		build/asm/code/func_a830.o(.text)
		build/asm/code/func_a8f8.o(.text)
		build/asm/code/func_a962.o(.text)
		build/asm/code/func_aa42.o(.text)
		build/asm/code/func_aa6c.o(.text)
		build/asm/code/func_aa90.o(.text)
		build/asm/code/func_aaa6.o(.text)
		build/asm/code/func_aae0.o(.text)
		build/asm/code/func_aaf0.o(.text)
		build/asm/code/func_ab00.o(.text)
		build/asm/code/func_ab10.o(.text)
		build/asm/code/func_ab5c.o(.text)
		build/asm/code/func_ab6c.o(.text)
		build/asm/code/func_ab94.o(.text)
		build/asm/code/func_aba2.o(.text)
		build/asm/code/func_abb0.o(.text)
		build/asm/code/func_abba.o(.text)
		build/asm/code/func_abda.o(.text)
		build/asm/code/func_ac1e.o(.text)
		build/asm/code/func_ad06.o(.text)
		build/asm/code/func_ad22.o(.text)
		build/asm/code/func_ad32.o(.text)
		build/asm/code/func_ad3a.o(.text)
		build/asm/code/func_ad4a.o(.text)
		build/asm/code/func_ad5a.o(.text)
		build/asm/code/func_ad6e.o(.text)
		build/asm/code/func_ad72.o(.text)
		build/asm/code/func_ad76.o(.text)
		build/asm/code/func_ad7a.o(.text)
		build/asm/code/func_ad84.o(.text)
		build/asm/code/func_ad8c.o(.text)
		build/asm/code/func_ad94.o(.text)
		build/asm/code/func_adae.o(.text)
		build/asm/code/func_adc8.o(.text)
		build/asm/code/func_adde.o(.text)
		build/asm/code/func_adf2.o(.text)
		build/asm/code/func_aebc.o(.text)
		build/asm/code/func_aef8.o(.text)
		build/asm/code/func_aefa.o(.text)
		build/asm/code/func_b0a2.o(.text)
		build/asm/code/func_b0ae.o(.text)
		build/asm/code/func_b0c8.o(.text)
		build/asm/code/func_b0f2.o(.text)
		build/asm/code/func_b124.o(.text)
		build/asm/code/func_b176.o(.text)
		build/asm/code/func_b1ae.o(.text)
		build/asm/code/func_b2e2.o(.text)
		build/asm/code/func_b390.o(.text)
		build/asm/code/func_b3c0.o(.text)
		build/asm/code/func_b3cc.o(.text)
		build/asm/code/func_b48c.o(.text)
		build/asm/code/func_b682.o(.text)
		build/asm/code/func_b7ee.o(.text)
		build/asm/code/func_b8a6.o(.text)
		build/asm/code/func_b8f2.o(.text)
		build/asm/code/func_b924.o(.text)
		build/asm/code/func_b94e.o(.text)
		build/asm/code/func_b98a.o(.text)
		build/asm/code/func_b99c.o(.text)
		build/asm/code/func_b9ae.o(.text)
		build/asm/code/func_b9ce.o(.text)
		build/asm/code/RegSave_er2_er6.o(.text)
		build/asm/code/InitSections.o(.text)
		build/asm/rodata.o(.text)
		build/asm/sectinit.o(.text)
	}
}
